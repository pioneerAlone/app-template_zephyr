## app/build/Kconfig/Kconfig.shield.defconfig
```kconfig
osource "/Users/wangbo/zephyrproject/custom_app/boards/shields/*/Kconfig.defconfig"
```

## app/build/Kconfig/arch/Kconfig
```kconfig
# Load Zephyr Arch Kconfig descriptions.
osource "/Users/wangbo/zephyrproject/external/zephyr/arch/rx/Kconfig"
osource "/Users/wangbo/zephyrproject/external/zephyr/arch/x86/Kconfig"
osource "/Users/wangbo/zephyrproject/external/zephyr/arch/xtensa/Kconfig"
osource "/Users/wangbo/zephyrproject/external/zephyr/arch/sparc/Kconfig"
osource "/Users/wangbo/zephyrproject/external/zephyr/arch/riscv/Kconfig"
osource "/Users/wangbo/zephyrproject/external/zephyr/arch/posix/Kconfig"
osource "/Users/wangbo/zephyrproject/external/zephyr/arch/mips/Kconfig"
osource "/Users/wangbo/zephyrproject/external/zephyr/arch/arm64/Kconfig"
osource "/Users/wangbo/zephyrproject/external/zephyr/arch/arm/Kconfig"
osource "/Users/wangbo/zephyrproject/external/zephyr/arch/arc/Kconfig"
```

## app/build/Kconfig/boards/Kconfig
```kconfig
# Load Zephyr board Kconfig descriptions.
osource "/Users/wangbo/zephyrproject/external/zephyr/boards/qemu/x86/Kconfig"
```

## app/build/Kconfig/boards/Kconfig.defconfig
```kconfig
# Load Zephyr board defconfig descriptions.
osource "/Users/wangbo/zephyrproject/external/zephyr/boards/qemu/x86/Kconfig.defconfig"
```

## app/build/Kconfig/boards/Kconfig.sysbuild
```kconfig
# Load Sysbuild board Kconfig descriptions.
osource "/Users/wangbo/zephyrproject/external/zephyr/boards/qemu/x86/Kconfig.sysbuild"
```

## app/build/Kconfig/soc/Kconfig
```kconfig
# Load Zephyr SoC Kconfig descriptions.
osource "/Users/wangbo/zephyrproject/external/zephyr/soc/xlnx/zynqmp/Kconfig"
osource "/Users/wangbo/zephyrproject/external/zephyr/soc/xlnx/zynq7000/Kconfig"
osource "/Users/wangbo/zephyrproject/external/zephyr/soc/xlnx/versalnet/Kconfig"
osource "/Users/wangbo/zephyrproject/external/zephyr/soc/xlnx/versal2/Kconfig"
osource "/Users/wangbo/zephyrproject/external/zephyr/soc/xen/Kconfig"
osource "/Users/wangbo/zephyrproject/external/zephyr/soc/wch/ch32v/Kconfig"
osource "/Users/wangbo/zephyrproject/external/zephyr/soc/ti/simplelink/Kconfig"
osource "/Users/wangbo/zephyrproject/external/zephyr/soc/ti/mspm0/Kconfig"
osource "/Users/wangbo/zephyrproject/external/zephyr/soc/ti/lm3s6965/Kconfig"
osource "/Users/wangbo/zephyrproject/external/zephyr/soc/ti/k3/Kconfig"
osource "/Users/wangbo/zephyrproject/external/zephyr/soc/telink/tlsr/Kconfig"
osource "/Users/wangbo/zephyrproject/external/zephyr/soc/starfive/jh71xx/Kconfig"
osource "/Users/wangbo/zephyrproject/external/zephyr/soc/st/stm32/Kconfig"
osource "/Users/wangbo/zephyrproject/external/zephyr/soc/snps/qemu_arc/Kconfig"
osource "/Users/wangbo/zephyrproject/external/zephyr/soc/snps/nsim/arc_v/Kconfig"
osource "/Users/wangbo/zephyrproject/external/zephyr/soc/snps/nsim/arc_classic/Kconfig"
osource "/Users/wangbo/zephyrproject/external/zephyr/soc/snps/hsdk4xd/Kconfig"
osource "/Users/wangbo/zephyrproject/external/zephyr/soc/snps/hsdk/Kconfig"
osource "/Users/wangbo/zephyrproject/external/zephyr/soc/snps/emsk/Kconfig"
osource "/Users/wangbo/zephyrproject/external/zephyr/soc/snps/emsdp/Kconfig"
osource "/Users/wangbo/zephyrproject/external/zephyr/soc/snps/arc_iot/Kconfig"
osource "/Users/wangbo/zephyrproject/external/zephyr/soc/silabs/Kconfig"
osource "/Users/wangbo/zephyrproject/external/zephyr/soc/sifli/sf32/Kconfig"
osource "/Users/wangbo/zephyrproject/external/zephyr/soc/sifive/sifive_freedom/Kconfig"
osource "/Users/wangbo/zephyrproject/external/zephyr/soc/sensry/Kconfig"
osource "/Users/wangbo/zephyrproject/external/zephyr/soc/rockchip/Kconfig"
osource "/Users/wangbo/zephyrproject/external/zephyr/soc/renode/riscv_virtual/Kconfig"
osource "/Users/wangbo/zephyrproject/external/zephyr/soc/renode/cortex_r8_virtual/Kconfig"
osource "/Users/wangbo/zephyrproject/external/zephyr/soc/renesas/smartbond/Kconfig"
osource "/Users/wangbo/zephyrproject/external/zephyr/soc/renesas/rz/Kconfig"
osource "/Users/wangbo/zephyrproject/external/zephyr/soc/renesas/rx/Kconfig"
osource "/Users/wangbo/zephyrproject/external/zephyr/soc/renesas/rcar/Kconfig"
osource "/Users/wangbo/zephyrproject/external/zephyr/soc/renesas/ra/Kconfig"
osource "/Users/wangbo/zephyrproject/external/zephyr/soc/realtek/ec/Kconfig"
osource "/Users/wangbo/zephyrproject/external/zephyr/soc/raspberrypi/rpi_pico/Kconfig"
osource "/Users/wangbo/zephyrproject/external/zephyr/soc/quicklogic/eos_s3/Kconfig"
osource "/Users/wangbo/zephyrproject/external/zephyr/soc/qemu/virt_riscv/Kconfig"
osource "/Users/wangbo/zephyrproject/external/zephyr/soc/qemu/malta/Kconfig"
osource "/Users/wangbo/zephyrproject/external/zephyr/soc/openisa/rv32m1/Kconfig"
osource "/Users/wangbo/zephyrproject/external/zephyr/soc/openhwgroup/cva6/Kconfig"
osource "/Users/wangbo/zephyrproject/external/zephyr/soc/oct/osd32mp15x/Kconfig"
osource "/Users/wangbo/zephyrproject/external/zephyr/soc/nxp/s32/Kconfig"
osource "/Users/wangbo/zephyrproject/external/zephyr/soc/nxp/rw/Kconfig"
osource "/Users/wangbo/zephyrproject/external/zephyr/soc/nxp/mcx/Kconfig"
osource "/Users/wangbo/zephyrproject/external/zephyr/soc/nxp/lpc/Kconfig"
osource "/Users/wangbo/zephyrproject/external/zephyr/soc/nxp/layerscape/Kconfig"
osource "/Users/wangbo/zephyrproject/external/zephyr/soc/nxp/kinetis/Kconfig"
osource "/Users/wangbo/zephyrproject/external/zephyr/soc/nxp/imxrt/Kconfig"
osource "/Users/wangbo/zephyrproject/external/zephyr/soc/nxp/imx/Kconfig"
osource "/Users/wangbo/zephyrproject/external/zephyr/soc/nuvoton/numicro/Kconfig"
osource "/Users/wangbo/zephyrproject/external/zephyr/soc/nuvoton/numaker/Kconfig"
osource "/Users/wangbo/zephyrproject/external/zephyr/soc/nuvoton/npcx/Kconfig"
osource "/Users/wangbo/zephyrproject/external/zephyr/soc/nuvoton/npcm/Kconfig"
osource "/Users/wangbo/zephyrproject/external/zephyr/soc/nordic/Kconfig"
osource "/Users/wangbo/zephyrproject/external/zephyr/soc/neorv32/Kconfig"
osource "/Users/wangbo/zephyrproject/external/zephyr/soc/native/inf_clock/Kconfig"
osource "/Users/wangbo/zephyrproject/external/zephyr/soc/microchip/sam/Kconfig"
osource "/Users/wangbo/zephyrproject/external/zephyr/soc/microchip/sam/sama7/Kconfig"
osource "/Users/wangbo/zephyrproject/external/zephyr/soc/microchip/sam/sam_d5x_e5x/Kconfig"
osource "/Users/wangbo/zephyrproject/external/zephyr/soc/microchip/pic32c/pic32cz_ca/Kconfig"
osource "/Users/wangbo/zephyrproject/external/zephyr/soc/microchip/pic32c/pic32cx_sg/Kconfig"
osource "/Users/wangbo/zephyrproject/external/zephyr/soc/microchip/pic32c/pic32cm_jh/Kconfig"
osource "/Users/wangbo/zephyrproject/external/zephyr/soc/microchip/miv/Kconfig"
osource "/Users/wangbo/zephyrproject/external/zephyr/soc/microchip/mec/Kconfig"
osource "/Users/wangbo/zephyrproject/external/zephyr/soc/mediatek/mt8xxx/Kconfig"
osource "/Users/wangbo/zephyrproject/external/zephyr/soc/lowrisc/opentitan/Kconfig"
osource "/Users/wangbo/zephyrproject/external/zephyr/soc/litex/litex_vexriscv/Kconfig"
osource "/Users/wangbo/zephyrproject/external/zephyr/soc/ite/ec/Kconfig"
osource "/Users/wangbo/zephyrproject/external/zephyr/soc/intel/raptor_lake/Kconfig"
osource "/Users/wangbo/zephyrproject/external/zephyr/soc/intel/panther_lake/Kconfig"
osource "/Users/wangbo/zephyrproject/external/zephyr/soc/intel/lakemont/Kconfig"
osource "/Users/wangbo/zephyrproject/external/zephyr/soc/intel/intel_socfpga_std/Kconfig"
osource "/Users/wangbo/zephyrproject/external/zephyr/soc/intel/intel_socfpga/Kconfig"
osource "/Users/wangbo/zephyrproject/external/zephyr/soc/intel/intel_niosv/Kconfig"
osource "/Users/wangbo/zephyrproject/external/zephyr/soc/intel/intel_ish/Kconfig"
osource "/Users/wangbo/zephyrproject/external/zephyr/soc/intel/intel_adsp/Kconfig"
osource "/Users/wangbo/zephyrproject/external/zephyr/soc/intel/elkhart_lake/Kconfig"
osource "/Users/wangbo/zephyrproject/external/zephyr/soc/intel/atom/Kconfig"
osource "/Users/wangbo/zephyrproject/external/zephyr/soc/intel/apollo_lake/Kconfig"
osource "/Users/wangbo/zephyrproject/external/zephyr/soc/intel/alder_lake/Kconfig"
osource "/Users/wangbo/zephyrproject/external/zephyr/soc/infineon/edge/Kconfig"
osource "/Users/wangbo/zephyrproject/external/zephyr/soc/infineon/cat3/Kconfig"
osource "/Users/wangbo/zephyrproject/external/zephyr/soc/infineon/cat1c/Kconfig"
osource "/Users/wangbo/zephyrproject/external/zephyr/soc/infineon/cat1b/Kconfig"
osource "/Users/wangbo/zephyrproject/external/zephyr/soc/infineon/cat1a/Kconfig"
osource "/Users/wangbo/zephyrproject/external/zephyr/soc/gd/gd32/Kconfig"
osource "/Users/wangbo/zephyrproject/external/zephyr/soc/gaisler/leon3/Kconfig"
osource "/Users/wangbo/zephyrproject/external/zephyr/soc/gaisler/gr716a/Kconfig"
osource "/Users/wangbo/zephyrproject/external/zephyr/soc/espressif/Kconfig"
osource "/Users/wangbo/zephyrproject/external/zephyr/soc/ene/kb1200/Kconfig"
osource "/Users/wangbo/zephyrproject/external/zephyr/soc/ene/kb106x/Kconfig"
osource "/Users/wangbo/zephyrproject/external/zephyr/soc/egis/Kconfig"
osource "/Users/wangbo/zephyrproject/external/zephyr/soc/efinix/sapphire/Kconfig"
osource "/Users/wangbo/zephyrproject/external/zephyr/soc/cdns/xtensa_sample_controller/Kconfig"
osource "/Users/wangbo/zephyrproject/external/zephyr/soc/cdns/sample_controller32/Kconfig"
osource "/Users/wangbo/zephyrproject/external/zephyr/soc/cdns/dc233c/Kconfig"
osource "/Users/wangbo/zephyrproject/external/zephyr/soc/brcm/bcmvk/Kconfig"
osource "/Users/wangbo/zephyrproject/external/zephyr/soc/brcm/bcm2712/Kconfig"
osource "/Users/wangbo/zephyrproject/external/zephyr/soc/brcm/bcm2711/Kconfig"
osource "/Users/wangbo/zephyrproject/external/zephyr/soc/bflb/Kconfig"
osource "/Users/wangbo/zephyrproject/external/zephyr/soc/atmel/sam0/Kconfig"
osource "/Users/wangbo/zephyrproject/external/zephyr/soc/atmel/sam/Kconfig"
osource "/Users/wangbo/zephyrproject/external/zephyr/soc/aspeed/Kconfig"
osource "/Users/wangbo/zephyrproject/external/zephyr/soc/arm/Kconfig"
osource "/Users/wangbo/zephyrproject/external/zephyr/soc/arm/beetle/Kconfig"
osource "/Users/wangbo/zephyrproject/external/zephyr/soc/antmicro/myra/Kconfig"
osource "/Users/wangbo/zephyrproject/external/zephyr/soc/andestech/Kconfig"
osource "/Users/wangbo/zephyrproject/external/zephyr/soc/amd/acp_6_0/Kconfig"
osource "/Users/wangbo/zephyrproject/external/zephyr/soc/ambiq/Kconfig"
osource "/Users/wangbo/zephyrproject/external/zephyr/soc/aesc/Kconfig"
osource "/Users/wangbo/zephyrproject/external/zephyr/soc/adi/max32/Kconfig"
```

## app/build/dev_stm32l475/Kconfig/Kconfig.modules
```kconfig
menu "custom_app (/Users/wangbo/zephyrproject/custom_app)"
osource "/Users/wangbo/zephyrproject/custom_app/Kconfig"
config ZEPHYR_CUSTOM_APP_MODULE
	bool
	default y
endmenu
menu "cmsis (/Users/wangbo/zephyrproject/external/modules/hal/cmsis)"
osource "$(ZEPHYR_CMSIS_KCONFIG)"
config ZEPHYR_CMSIS_MODULE
	bool
	default y
endmenu
menu "cmsis-dsp (/Users/wangbo/zephyrproject/external/modules/lib/cmsis-dsp)"
osource "$(ZEPHYR_CMSIS_DSP_KCONFIG)"
config ZEPHYR_CMSIS_DSP_MODULE
	bool
	default y
endmenu
menu "cmsis_6 (/Users/wangbo/zephyrproject/external/modules/hal/cmsis_6)"
osource "$(ZEPHYR_CMSIS_6_KCONFIG)"
config ZEPHYR_CMSIS_6_MODULE
	bool
	default y
endmenu
menu "hal_espressif (/Users/wangbo/zephyrproject/external/modules/hal/espressif)"
osource "/Users/wangbo/zephyrproject/external/modules/hal/espressif/zephyr/Kconfig"
config ZEPHYR_HAL_ESPRESSIF_MODULE
	bool
	default y

config ZEPHYR_HAL_ESPRESSIF_MODULE_BLOBS
	bool
endmenu
menu "hal_nordic (/Users/wangbo/zephyrproject/external/modules/hal/nordic)"
osource "$(ZEPHYR_HAL_NORDIC_KCONFIG)"
config ZEPHYR_HAL_NORDIC_MODULE
	bool
	default y

config ZEPHYR_HAL_NORDIC_MODULE_BLOBS
	bool
endmenu
config ZEPHYR_HAL_STM32_MODULE
	bool
	default y

config ZEPHYR_HAL_STM32_MODULE_BLOBS
	bool
config ZEPHYR_LIBMETAL_MODULE
	bool
	default y
menu "littlefs (/Users/wangbo/zephyrproject/external/modules/fs/littlefs)"
osource "$(ZEPHYR_LITTLEFS_KCONFIG)"
config ZEPHYR_LITTLEFS_MODULE
	bool
	default y
endmenu
menu "mbedtls (/Users/wangbo/zephyrproject/external/modules/crypto/mbedtls)"
osource "$(ZEPHYR_MBEDTLS_KCONFIG)"
config ZEPHYR_MBEDTLS_MODULE
	bool
	default y
endmenu
config ZEPHYR_MCUBOOT_MODULE
	bool
	default y
menu "picolibc (/Users/wangbo/zephyrproject/external/modules/lib/picolibc)"
osource "/Users/wangbo/zephyrproject/external/modules/lib/picolibc/zephyr/Kconfig"
config ZEPHYR_PICOLIBC_MODULE
	bool
	default y
endmenu
menu "segger (/Users/wangbo/zephyrproject/external/modules/debug/segger)"
osource "$(ZEPHYR_SEGGER_KCONFIG)"
config ZEPHYR_SEGGER_MODULE
	bool
	default y
endmenu
menu "zcbor (/Users/wangbo/zephyrproject/external/modules/lib/zcbor)"
osource "$(ZEPHYR_ZCBOR_KCONFIG)"
config ZEPHYR_ZCBOR_MODULE
	bool
	default y
endmenu
```

## app/build/dev_stm32l475/Kconfig/Kconfig.shield
```kconfig
osource "/Users/wangbo/zephyrproject/custom_app/boards/shields/*/Kconfig.shield"
osource "/Users/wangbo/zephyrproject/custom_app/boards/shields/*/Kconfig.shield"
```

## app/build/dev_stm32l475/Kconfig/Kconfig.sysbuild.modules
```kconfig
config ZEPHYR_CUSTOM_APP_MODULE
   bool
   default y
config ZEPHYR_CMSIS_MODULE
   bool
   default y
config ZEPHYR_CMSIS_DSP_MODULE
   bool
   default y
config ZEPHYR_CMSIS_6_MODULE
   bool
   default y
config ZEPHYR_HAL_ESPRESSIF_MODULE
   bool
   default y
config ZEPHYR_HAL_NORDIC_MODULE
   bool
   default y
config ZEPHYR_HAL_STM32_MODULE
   bool
   default y
config ZEPHYR_LIBMETAL_MODULE
   bool
   default y
config ZEPHYR_LITTLEFS_MODULE
   bool
   default y
config ZEPHYR_MBEDTLS_MODULE
   bool
   default y
config ZEPHYR_MCUBOOT_MODULE
   bool
   default y
config ZEPHYR_PICOLIBC_MODULE
   bool
   default y
config ZEPHYR_SEGGER_MODULE
   bool
   default y
config ZEPHYR_ZCBOR_MODULE
   bool
   default y
```

## app/build/dev_stm32l475/Kconfig/boards/Kconfig
```kconfig
# Load Zephyr board Kconfig descriptions.
osource "/Users/wangbo/zephyrproject/custom_app/boards/vendor/dev_stm32l475/Kconfig"
```

## app/build/dev_stm32l475/Kconfig/boards/Kconfig.defconfig
```kconfig
# Load Zephyr board defconfig descriptions.
osource "/Users/wangbo/zephyrproject/custom_app/boards/vendor/dev_stm32l475/Kconfig.defconfig"
```

## app/build/dev_stm32l475/Kconfig/boards/Kconfig.dev_stm32l475
```kconfig
# Load board Kconfig descriptions.
osource "/Users/wangbo/zephyrproject/custom_app/boards/vendor/dev_stm32l475/Kconfig.dev_stm32l475"
```

## app/build/qemu_cortex_m3/Kconfig/boards/Kconfig.defconfig
```kconfig
# Load Zephyr board defconfig descriptions.
osource "/Users/wangbo/zephyrproject/external/zephyr/boards/qemu/cortex_m3/Kconfig.defconfig"
```

## app/build/qemu_cortex_m3/Kconfig/boards/Kconfig.qemu_cortex_m3
```kconfig
# Load board Kconfig descriptions.
osource "/Users/wangbo/zephyrproject/external/zephyr/boards/qemu/cortex_m3/Kconfig.qemu_cortex_m3"
```

## app/build/qemu_cortex_m3/Kconfig/boards/Kconfig.sysbuild
```kconfig
# Load Sysbuild board Kconfig descriptions.
osource "/Users/wangbo/zephyrproject/external/zephyr/boards/qemu/cortex_m3/Kconfig.sysbuild"
```

## boards/vendor/dev_stm32l475/Kconfig.dev_stm32l475
```kconfig
# Copyright (c) 2023 Tisilicon
# SPDX-License-Identifier: Apache-2.0


config BOARD_DEV_STM32L475
	bool "Custom STM32L475 Development Board"
	select SOC_STM32L475XX
	
```

## boards/vendor/dev_stm32l475/board.yml
```yaml
board:
  name: dev_stm32l475
  full_name: STM32L475-Dev
  vendor: vendor
  socs:
    - name: stm32l475xx
```

## drivers/sensor/Kconfig
```kconfig
# Copyright (c) 2021 Nordic Semiconductor ASA
# SPDX-License-Identifier: Apache-2.0

source "$(ZEPHYR_CUSTOM_APP_DIR)/drivers/sensor/example_sensor/Kconfig"
source "$(ZEPHYR_CUSTOM_APP_DIR)/drivers/sensor/aht10/Kconfig"
```

## drivers/sensor/aht10/Kconfig
```kconfig
# Copyright (c) 2024 Custom App Contributors
# SPDX-License-Identifier: Apache-2.0

config AHT10
	bool "Aosong AHT10 temperature and humidity sensor"
	default y
	depends on DT_HAS_AOSONG_AHT10_ENABLED
	select I2C
	help
	  Enable Aosong AHT10 temperature and humidity sensor
```
